## 43xxx_Wi-Fi/WICED/RTOS/NuttX/ver7.8/arch/arm/src/bcm4390x/Kconfig
```kconfig
#
# Copyright 2017, Cypress Semiconductor Corporation or a subsidiary of 
 # Cypress Semiconductor Corporation. All Rights Reserved.
 # This software, including source code, documentation and related
 # materials ("Software"), is owned by Cypress Semiconductor Corporation
 # or one of its subsidiaries ("Cypress") and is protected by and subject to
 # worldwide patent protection (United States and foreign),
 # United States copyright laws and international treaty provisions.
 # Therefore, you may use this Software only as provided in the license
 # agreement accompanying the software package from which you
 # obtained this Software ("EULA").
 # If no EULA applies, Cypress hereby grants you a personal, non-exclusive,
 # non-transferable license to copy, modify, and compile the Software
 # source code solely for use in connection with Cypress's
 # integrated circuit products. Any reproduction, modification, translation,
 # compilation, or representation of this Software except as specified
 # above is prohibited without the express written permission of Cypress.
 #
 # Disclaimer: THIS SOFTWARE IS PROVIDED AS-IS, WITH NO WARRANTY OF ANY KIND,
 # EXPRESS OR IMPLIED, INCLUDING, BUT NOT LIMITED TO, NONINFRINGEMENT, IMPLIED
 # WARRANTIES OF MERCHANTABILITY AND FITNESS FOR A PARTICULAR PURPOSE. Cypress
 # reserves the right to make changes to the Software without notice. Cypress
 # does not assume any liability arising out of the application or use of the
 # Software or any product or circuit described in the Software. Cypress does
 # not authorize its products for use in any products where a malfunction or
 # failure of the Cypress product may reasonably be expected to result in
 # significant property damage, injury or death ("High Risk Product"). By
 # including Cypress's product in a High Risk Product, the manufacturer
 # of such system or application assumes all risk of such use and in doing
 # so agrees to indemnify Cypress against all liability.
#
#
# For a description of the syntax of this configuration file,
# see misc/tools/kconfig-language.txt.
#

if ARCH_CHIP_BCM4390X

comment "BCM4390X Configuration Options"

config BCM4390X_UART0
	bool "UART0"
	default y
	select ARCH_HAVE_UART0

config BCM4390X_UART1
	bool "UART1"
	default y
	select ARCH_HAVE_UART1

config BCM4390X_SPI1
	bool "SPI1"
	default n
	select SPI
	select SPI_EXCHANGE
	---help---
		Support SPI1

config BCM4390X_SPI2
	bool "SPI2"
	default n
	select SPI
	select SPI_EXCHANGE
	---help---
		Support SPI2

config BCM4390X_DIRECT_SFLASH
	bool "DIRECT_SFLASH"
	default y

config BCM4390X_WWD
	bool "WWD"
	default y
	depends on NET
	select ARCH_HAVE_PHY
	select ARCH_PHY_INTERRUPT

endif # ARCH_CHIP_BCM4390X
```

## 43xxx_Wi-Fi/WICED/RTOS/NuttX/ver7.8/net/rts/Kconfig
```kconfig
#
# For a description of the syntax of this configuration file,
# see misc/tools/kconfig-language.txt.
#

menu "Route (AF_ROUTE) Socket support"

config NET_RTS
	bool "Route socket"
	default n
	depends on NET
    select NET_IOB
	---help---
		Enable or disable AF_ROUTE socket support.

endmenu # Route Socket Support
```
